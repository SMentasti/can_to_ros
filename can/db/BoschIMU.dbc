VERSION ""

NS_ :

BS_:

BU_: InvMot InvGen Receiver BBS VCU Inverter

BO_ 380 IMU03: 8 Vector__XXX
 SG_ Az : 32|16@1+ (0.0001274,-4.1746432) [-4.1746432|4.1745158] "g" Vector__XXX

BO_ 376 IMU02: 8 Vector__XXX
 SG_ Ax : 32|16@1+ (0.0001274,-4.1746432) [-4.1746432|4.1745158] "g" Vector__XXX
 SG_ RollRate : 0|16@1+ (0.005,-163.84) [-163.84|163.835] "deg/s" Vector__XXX

BO_ 372 IMU01: 8 Vector__XXX
 SG_ Ay : 32|16@1+ (0.0001274,-4.1746432) [-4.1746432|4.1745158] "g" Vector__XXX
 SG_ YawRate : 0|16@1+ (0.005,-163.84) [-163.84|163.835] "deg/s" Vector__XXX

CM_ "C-CAN - Protocol - 29 bit";
CM_ BU_ Inverter "Inverter";
BA_DEF_ SG_  "GenSigSendType" ENUM  "Cyclic","OnWrite","OnWriteWithRepetition","OnChange","OnChangeWithRepetition","IfActive","IfActiveWithRepetition","NoSigSendType";
BA_DEF_ BO_  "NmMessage" ENUM  "No","Yes";
BA_DEF_ BO_  "TpOwnSystemEcuNumber" HEX 0 255;
BA_DEF_ BU_  "TpTxIdentifier" HEX 0 1968;
BA_DEF_ BU_  "TpRxIdentifier" HEX 0 1984;
BA_DEF_ BU_  "TpRxMask" HEX 0 2047;
BA_DEF_ BU_  "TpNodeAddress" HEX 0 2047;
BA_DEF_ BU_  "TpCanBus" STRING ;
BA_DEF_ BU_  "NodeLayerModules" STRING ;
BA_DEF_ BU_  "Node Address" INT 0 31;
BA_DEF_ BU_  "Description" STRING ;
BA_DEF_ BU_  "Node Diag Address" STRING ;
BA_DEF_ BU_  "TpNodeBaseAddress" HEX 0 2047;
BA_DEF_ BU_  "NmType" ENUM  "FIAT","None","Fiat_Class_C";
BA_DEF_ BU_  "NmStationAddress" HEX 0 31;
BA_DEF_ BU_  "NmNode" ENUM  "No","Yes";
BA_DEF_ BU_  "ILUsed" ENUM  "No","Yes";
BA_DEF_ BU_  "NwmNodeType" ENUM  "kMaster","kSlave15","kSlave30","none";
BA_DEF_  "ILTxTimeout" INT 0 10000;
BA_DEF_  "Manufacturer" STRING ;
BA_DEF_DEF_  "GenSigSendType" "NoSigSendType";
BA_DEF_DEF_  "NmMessage" "Yes";
BA_DEF_DEF_  "TpOwnSystemEcuNumber" 241;
BA_DEF_DEF_  "TpTxIdentifier" 1536;
BA_DEF_DEF_  "TpRxIdentifier" 1536;
BA_DEF_DEF_  "TpRxMask" 1536;
BA_DEF_DEF_  "TpNodeAddress" 1536;
BA_DEF_DEF_  "TpCanBus" "1";
BA_DEF_DEF_  "NodeLayerModules" "Osek_TP.dll;FiatNM_B.dll";
BA_DEF_DEF_  "Node Address" 0;
BA_DEF_DEF_  "Description" "";
BA_DEF_DEF_  "Node Diag Address" "";
BA_DEF_DEF_  "TpNodeBaseAddress" 1536;
BA_DEF_DEF_  "NmType" "FIAT";
BA_DEF_DEF_  "NmStationAddress" 0;
BA_DEF_DEF_  "NmNode" "No";
BA_DEF_DEF_  "ILUsed" "Yes";
BA_DEF_DEF_  "NwmNodeType" "none";
BA_DEF_DEF_  "ILTxTimeout" 50;
BA_DEF_DEF_  "Manufacturer" "Tarsi";
BA_ "NmNode" BU_ Inverter 1;
BA_ "NmStationAddress" BU_ Inverter 1;
BA_ "Node Diag Address" BU_ Inverter "16";
BA_ "Description" BU_ Inverter "Logica Inverter";
BA_ "Node Address" BU_ Inverter 1;
